## CMakeLists.txt
```
# SPDX-License-Identifier: Apache-2.0

cmake_minimum_required(VERSION 3.20.0)
set(DTC_OVERLAY_FILE pwm0_en.overlay leds.dtsi)
set(BOARD thingy52_nrf52832)
set(BOARD_FLASH_RUNNER jlink)

find_package(Zephyr REQUIRED HINTS $ENV{ZEPHYR_BASE})
project(spkr_sample)

target_sources(app PRIVATE src/main.c)
```

## prj.conf
```kconfig
CONFIG_GPIO=y
CONFIG_REGULATOR=y
CONFIG_PWM=y

#-----------------------------RTT_CONFIG--------------------------------------
CONFIG_USE_SEGGER_RTT=y
CONFIG_SHELL_BACKEND_RTT=y
#-----------------------------------------------------------------------------

#-----------------------------SHELL_CONF--------------------------------------
CONFIG_SHELL_BACKEND_SERIAL_CHECK_DTR=y
CONFIG_UART_LINE_CTRL=y
CONFIG_SHELL_BACKEND_SERIAL_INIT_PRIORITY=51
CONFIG_SHELL=y
CONFIG_SHELL_BACKENDS=y
CONFIG_SHELL_BACKEND_SERIAL=y

CONFIG_SHELL_PROMPT_RTT="csse4011:~$"

CONFIG_SHELL_CMDS=y
CONFIG_SHELL_TAB=y
CONFIG_SHELL_TAB_AUTOCOMPLETION=y
CONFIG_SHELL_VT100_COLORS=y
CONFIG_KERNEL_SHELL=y
#-----------------------------------------------------------------------------

#-----------------------------SHELL_LOGGING-----------------------------------
CONFIG_LOG=y
CONFIG_LOG_PRINTK=y
CONFIG_PWM_LOG_LEVEL_DBG=y
#-----------------------------------------------------------------------------
```

## leds.dtsi
```dts
/ {
    aliases {
            led1 = &led1;
            led2 = &led2;
    };
};
```

## pwm0_en.overlay
```dts
&pwm0 {
    status = "okay";
    ch0-pin = <0x1b>;
};
```

## src/main.c
```c
/*
 * Thingy52: Speaker Sample
 *
 * Auth: Wilfred MK
 * Mail: wilfred.mallawa@wdc.com
 * Date: 20/03/2022
 */
#include <zephyr.h>
#include <drivers/gpio.h>
#include <device.h>
#include <drivers/sensor.h>
#include <drivers/regulator.h>
#include <logging/log.h>
#include <drivers/pwm.h>

/* Define logging module */
LOG_MODULE_REGISTER(speaker_sample, LOG_LEVEL_DBG);

/* 1000 msec = 1 sec */
#define SLEEP_TIME_MS   1000
/* The devicetree node identifier for the "led0" alias. */
#define LED0_NODE DT_ALIAS(led0)
#define LED1_NODE DT_ALIAS(led1)
#define LED2_NODE DT_ALIAS(led2)

/* PWM */
#define PWM_PIN 		0x1b
#define PERIOD_1		(USEC_PER_SEC / 500U)
#define PERIOD_2 		(USEC_PER_SEC / 800U)
#define P_WIDTH 		1000 //ms

/*
 * A build error on this line means your board is unsupported.
 * See the sample documentation for information on how to fix this.
 */
static const struct gpio_dt_spec led0 = GPIO_DT_SPEC_GET(LED0_NODE, gpios);
static const struct gpio_dt_spec led1 = GPIO_DT_SPEC_GET(LED1_NODE, gpios);
static const struct gpio_dt_spec led2 = GPIO_DT_SPEC_GET(LED2_NODE, gpios);

/* Request to turn on the PWR_REG for the speaker */
int set_spk_pwr_on(void)
{
	const struct device *spk_reg = DEVICE_DT_GET(DT_NODELABEL(spk_pwr));
	int rc = 0;

	if (!(rc = device_is_ready(spk_reg))) {
		LOG_ERR("Speaker regulator device not ready");
		return rc;
	}

	/* Initiation success on non-neg return
	 * NOTE: Ideally instead of passing NULL, setup a callback handler
	 * 		 to verify that the reg is enabled.
	 * This assumes, it setup and doesn't actually check.
	 */
	if ((rc = regulator_enable(spk_reg, NULL)) < 0) {
		return rc;
	}

	LOG_INF("Reg init request OK");
	return 0;
}

void main(void)
{
	const struct device *pwm;
	uint32_t period;
	int ret;
	bool turn = false;

	if (!device_is_ready(led0.port) || !device_is_ready(led1.port) ||
		!device_is_ready(led2.port)) {
		return;
	}

	ret = gpio_pin_configure_dt(&led0, GPIO_OUTPUT_ACTIVE) |
			gpio_pin_configure_dt(&led2, GPIO_OUTPUT_ACTIVE);

	if (ret != 0) {
		return;
	}

	if (set_spk_pwr_on() != 0) {
		LOG_ERR("REG enable failed");
	}

	pwm = device_get_binding(DT_LABEL(DT_NODELABEL(pwm0)));

	if (!device_is_ready(pwm)) {
		LOG_ERR("PWM not ready");
	}

	while (1) {
		ret = gpio_pin_toggle_dt(&led0);
		if (ret < 0) {
			return;
		}

		period = turn ? PERIOD_1: PERIOD_2;
		turn = !turn;

		if (pwm_pin_set_usec(pwm, PWM_PIN, period, P_WIDTH, 0)) {
			LOG_ERR("PWM set fail");
		}

		LOG_INF("Setting PWM - period %d, width: %d", period, P_WIDTH);
		k_msleep(SLEEP_TIME_MS);

		if (pwm_pin_set_usec(pwm, PWM_PIN, period, 0, 0)) {
			LOG_ERR("PWM clear fail");
		}

		ret = gpio_pin_toggle_dt(&led2);
		if (ret < 0) {
			return;
		}
		LOG_INF("Clearing PWM - period %d, width: %d", period, 0);
		k_msleep(SLEEP_TIME_MS);
	}
}
```
